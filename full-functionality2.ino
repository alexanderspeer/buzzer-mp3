/*
  3-Button, 3-Song Buzzer Player + OLED (SSD1306 128x64 I2C)

  Buttons:
    A1 toggles Song 1  (Space Oddity)
    A2 toggles Song 2  (Mandy)
    A3 toggles Song 3  (The Gambler)

  Behavior:
  - If nothing playing: press Ax -> start that song (plays through, then stops).
  - If a song is playing:
      * press SAME button -> stop it immediately
      * press DIFFERENT button -> stop current immediately and start the new song

  OLED behavior:
  - Base state: alternates between 2 bitmap images every 2 seconds.
  - On start/switch: shows "Now playing <Title>" for 2 seconds, then returns to images.
  - On stop (same button): shows "Stopped playing <Title>" for 2 seconds, then returns to images.

  Wiring:
  - Buttons: Ax to GND (INPUT_PULLUP, pressed = LOW)
  - Buzzer: D9
  - OLED: SDA=A4, SCL=A5, addr 0x3C

  You will paste:
  - Song 1 arrays
  - Song 2 arrays
  - Song 3 arrays
  - Image 1 bitmap
  - Image 2 bitmap
*/

#include <Arduino.h>
#include <avr/pgmspace.h>
#include <Wire.h>
#include <Adafruit_GFX.h>
#include <Adafruit_SSD1306.h>

// ---------------------- Pins ----------------------
const uint8_t BUZZ_PIN = 9;

const uint8_t BTN1_PIN = A1;
const uint8_t BTN2_PIN = A2;
const uint8_t BTN3_PIN = A3;

// ---------------------- OLED ----------------------
#define SCREEN_WIDTH 128
#define SCREEN_HEIGHT 64
#define OLED_ADDR 0x3C

Adafruit_SSD1306 display(SCREEN_WIDTH, SCREEN_HEIGHT, &Wire, -1);

const uint16_t SWAP_MS = 2000;          // swap images every 2s
const uint16_t MSG_SHOW_MS = 2000;      // show status text for 2s

// ---------------------- Playback tuning ----------------------
const uint16_t SPEED_PCT = 100;    // 100 = original timing
const uint8_t  EXTRA_GAP_MS = 2;   // small gap after each event

// ---------------------- Debounce ----------------------
const uint16_t DEBOUNCE_MS = 35;

const uint16_t N_EVENTS_SONG1 = 328;

// 0 freq means rest. Arrays aligned by event index.
const uint16_t SONG1_FREQ_HZ[] PROGMEM = {
  262, 0, 262, 0, 262, 0, 262, 0, 262, 247, 0, 262, 0, 294, 0, 262,
  0, 294, 0, 262, 0, 294, 0, 262, 0, 294, 0, 262, 0, 294, 0, 262,
  0, 330, 0, 330, 0, 330, 0, 349, 0, 392, 0, 392, 0, 392, 0, 349,
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  0, 196, 220, 0, 196, 175, 0, 175
};

const uint16_t SONG1_DUR_MS[] PROGMEM = {
  331, 106, 72, 145, 469, 179, 79, 140, 874, 2360, 2000, 290, 140, 256, 181, 251,
  186, 251, 179, 362, 72, 258, 181, 285, 145, 256, 179, 367, 68, 79, 138, 1889,
  2000, 220, 102, 469, 183, 362, 75, 106, 77, 577, 106, 111, 106, 584, 70, 145,
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  109, 399, 618, 34, 224, 136, 70, 2625
};

const uint16_t SONG1_GATE_MS[] PROGMEM = {
  298, 0, 65, 0, 422, 0, 71, 0, 787, 2124, 0, 261, 0, 230, 0, 226,
  0, 226, 0, 326, 0, 232, 0, 257, 0, 230, 0, 330, 0, 71, 0, 1700,
  0, 198, 0, 422, 0, 326, 0, 96, 0, 520, 0, 100, 0, 526, 0, 130,
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  0, 359, 556, 0, 202, 122, 0, 2362
};



// =======================================================
// >>>>>> PASTE SONG 2 ARRAYS HERE <<<<<<
// =======================================================
// Generated from: Barry_Manilow_-_Mandy.mid
// Track: Melody
// Total events (notes + rests): 115

const uint16_t N_EVENTS_SONG2 = 115;

// 0 freq means rest. Arrays aligned by event index.
const uint16_t SONG2_FREQ_HZ[] PROGMEM = {
  349, 392, 466, 392, 587, 392, 349, 349, 392, 466, 392, 587, 392, 349, 622, 587,
  587, 523, 523, 392, 622, 587, 523, 622, 698, 622, 587, 523, 622, 587, 523, 587,
  523, 466, 392, 349, 392, 466, 392, 587, 392, 349, 349, 392, 466, 392, 523, 587,
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  587, 523, 466
};

const uint16_t SONG2_DUR_MS[] PROGMEM = {
  264, 322, 288, 269, 577, 308, 2538, 303, 288, 298, 264, 562, 312, 2572, 418, 361,
  168, 236, 846, 303, 312, 553, 1418, 370, 534, 130, 125, 1202, 327, 288, 308, 519,
  303, 284, 279, 279, 284, 298, 255, 611, 284, 2615, 269, 312, 288, 298, 87, 466,
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  577, 577, 8942
};

const uint16_t SONG2_GATE_MS[] PROGMEM = {
  238, 290, 260, 242, 519, 277, 2285, 273, 260, 268, 238, 506, 281, 2315, 376, 325,
  151, 212, 762, 273, 281, 498, 1276, 333, 480, 117, 112, 1082, 294, 260, 277, 467,
  273, 255, 251, 251, 255, 268, 229, 550, 255, 2354, 242, 281, 260, 268, 78, 420,
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  519, 519, 8048
};



// =======================================================
// >>>>>> PASTE SONG 3 ARRAYS HERE <<<<<<
// =======================================================
// Generated from: Kenny_Rogers_-_The_Gambler.mid
// Track: MELODY
// Total events (notes + rests): 824

const uint16_t N_EVENTS_SONG3 = 824;

// 0 freq means rest. Arrays aligned by event index.
const uint16_t SONG3_FREQ_HZ[] PROGMEM = {
  311, 0, 311, 0, 311, 0, 311, 0, 311, 0, 311, 0, 311, 0, 311, 0,
  415, 0, 415, 0, 466, 0, 523, 0, 466, 0, 392, 0, 466, 0, 523, 0,
  466, 0, 392, 0, 392, 0, 311, 0, 311, 0, 311, 0, 311, 0, 349, 0,
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  0, 370, 0, 370, 0, 415, 311, 330
};

const uint16_t SONG3_DUR_MS[] PROGMEM = {
  86, 81, 83, 83, 542, 125, 203, 131, 67, 100, 292, 208, 553, 114, 214, 119,
  150, 183, 253, 81, 128, 206, 83, 83, 481, 19, 878, 456, 181, 153, 442, 58,
  419, 81, 511, 156, 283, 50, 144, 189, 164, 169, 206, 128, 133, 33, 1036, 131,
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  392, 89, 78, 106, 61, 344, 167, 4589
};

const uint16_t SONG3_GATE_MS[] PROGMEM = {
  77, 0, 75, 0, 487, 0, 182, 0, 60, 0, 262, 0, 497, 0, 192, 0,
  135, 0, 227, 0, 115, 0, 75, 0, 432, 0, 790, 0, 162, 0, 397, 0,
  377, 0, 460, 0, 255, 0, 130, 0, 147, 0, 185, 0, 120, 0, 932, 0,
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  0, 80, 0, 95, 0, 310, 150, 4130
};


// Image 1 (from your earlier message)
// 'Gemini_Generated_Image_efatmoefatmoefat', 128x64px
const unsigned char epd_bitmap_Gemini_Generated_Image_efatmoefatmoefat [] PROGMEM = {
	0x00, 0x00, 0x00, 0x00, 0x00, 0x00, 0x00, 0x00, 0x00, 0x00, 0x00, 0x00, 0x00, 0x00, 0x00, 0x00, 
	0x00, 0x00, 0x00, 0x00, 0x00, 0x00, 0x00, 0x00, 0x00, 0x00, 0x00, 0x00, 0x00, 0x00, 0x00, 0x00, 
	0x00, 0x00, 0x00, 0x00, 0x00, 0x00, 0x00, 0x00, 0x00, 0x00, 0x00, 0x00, 0x00, 0x00, 0x00, 0x00, 
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	0xff, 0xff, 0xff, 0xff, 0xff, 0xff, 0xff, 0xff, 0xff, 0xff, 0xff, 0xff, 0xff, 0xff, 0xff, 0xff
};

// Image 2 (from this message)
// 'Gemini_Generated_Image_9wyb469wyb469wyb', 128x64px
const unsigned char epd_bitmap_Gemini_Generated_Image_9wyb469wyb469wyb [] PROGMEM = {
	0x00, 0x00, 0x00, 0x00, 0x00, 0x00, 0x00, 0x00, 0x00, 0x00, 0x00, 0x00, 0x00, 0x00, 0x00, 0x00, 
	0x00, 0x00, 0x00, 0x00, 0x00, 0x00, 0x00, 0x01, 0x00, 0x00, 0x00, 0x00, 0x00, 0x00, 0x00, 0x00, 
	0x00, 0x00, 0x00, 0x00, 0x00, 0x00, 0x00, 0x01, 0xc0, 0x00, 0x00, 0x00, 0x00, 0x00, 0x00, 0x00, 
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	0xff, 0xff, 0xff, 0xff, 0xff, 0xff, 0xff, 0xff, 0xff, 0xff, 0xff, 0xff, 0xff, 0xff, 0xff, 0xff
};


// =======================================================
// Internal state
// =======================================================

enum SongId : uint8_t { SONG_NONE = 0, SONG_1 = 1, SONG_2 = 2, SONG_3 = 3 };

static SongId currentSong = SONG_NONE;
static bool isPlaying = false;

// When true, the currently playing song should stop ASAP.
static volatile bool stopRequested = false;

// Switch support: when switching, we stop current, then immediately start this song next.
static bool switchPending = false;
static SongId nextSong = SONG_NONE;

// Debounce state for each button
static bool stable1 = false, stable2 = false, stable3 = false; // debounced pressed
static bool raw1 = false, raw2 = false, raw3 = false;          // last raw pressed
static uint32_t lastChange1 = 0, lastChange2 = 0, lastChange3 = 0;

// OLED rotation state
static uint8_t currentImage = 0;
static uint32_t lastSwapMs = 0;

// OLED message overlay state
static bool msgActive = false;
static uint32_t msgUntilMs = 0;
static const __FlashStringHelper *msgLine1 = nullptr;
static const char *msgLine2 = nullptr;

// After you paste the two bitmaps, these will point at them.
static const unsigned char* const images[] PROGMEM = {
  epd_bitmap_Gemini_Generated_Image_efatmoefatmoefat,
  epd_bitmap_Gemini_Generated_Image_9wyb469wyb469wyb
};
static const uint8_t IMAGE_COUNT = sizeof(images) / sizeof(images[0]);

// Song title lookup (for OLED)
static const char* songTitle(SongId s) {
  switch (s) {
    case SONG_1: return "Space Oddity";
    case SONG_2: return "Mandy";
    case SONG_3: return "The Gambler";
    default:     return "";
  }
}

// ---------------------- Helpers ----------------------

static uint16_t scaleMs(uint16_t ms) {
  return (uint32_t)ms * (uint32_t)SPEED_PCT / 100UL;
}

// Debounced press edge: returns true once on not pressed -> pressed
static bool pressedEdge(uint8_t pin, bool &stablePressed, bool &lastRawPressed, uint32_t &lastChangeMs) {
  bool rawPressedNow = (digitalRead(pin) == LOW); // INPUT_PULLUP: LOW means pressed

  if (rawPressedNow != lastRawPressed) {
    lastRawPressed = rawPressedNow;
    lastChangeMs = millis();
  }

  if ((millis() - lastChangeMs) > DEBOUNCE_MS) {
    if (stablePressed != rawPressedNow) {
      stablePressed = rawPressedNow;
      if (stablePressed) return true;
    }
  }
  return false;
}

static void requestStop() {
  stopRequested = true;
  noTone(BUZZ_PIN);
}

// ---------------------- OLED drawing ----------------------

static void drawBitmapByIndex(uint8_t idx) {
  display.clearDisplay();
  const unsigned char* img = (const unsigned char*)pgm_read_ptr(&images[idx]);
  display.drawBitmap(0, 0, img, 128, 64, SSD1306_WHITE);
  display.display();
}

static void showMessage(const __FlashStringHelper *line1, const char *line2) {
  msgActive = true;
  msgUntilMs = millis() + MSG_SHOW_MS;
  msgLine1 = line1;
  msgLine2 = line2;

  display.clearDisplay();
  display.setTextColor(SSD1306_WHITE);

  display.setTextSize(1);
  display.setCursor(0, 18);
  display.print(msgLine1);

  display.setTextSize(1);
  display.setCursor(0, 34);
  display.print(msgLine2);

  display.display();
}

static void oledTick() {
  uint32_t now = millis();

  // If message overlay is active, keep it until it expires
  if (msgActive) {
    if ((int32_t)(now - msgUntilMs) >= 0) {
      msgActive = false;
      lastSwapMs = now;
      drawBitmapByIndex(currentImage);
    }
    return;
  }

  // Base state: swap images every SWAP_MS (always, even while song plays)
  if (now - lastSwapMs >= SWAP_MS) {
    lastSwapMs = now;
    currentImage = (currentImage + 1) % IMAGE_COUNT;
    drawBitmapByIndex(currentImage);
  }
}

// ---------------------- Button -> Song control ----------------------

static void startSong(SongId s) {
  currentSong = s;
  isPlaying = true;
  stopRequested = false;
  switchPending = false;
  nextSong = SONG_NONE;

  showMessage(F("Now playing"), songTitle(s));
}

static void stopSong(SongId s) {
  // s is the song being stopped (for correct OLED message)
  requestStop();
  switchPending = false;
  nextSong = SONG_NONE;

  showMessage(F("Stopped playing"), songTitle(s));
}

static void switchSong(SongId from, SongId to) {
  // Stop current ASAP, then start next immediately after the playback loop exits
  requestStop();
  switchPending = true;
  nextSong = to;

  showMessage(F("Now playing"), songTitle(to));
}

static void handleSongButton(SongId requested) {
  if (!isPlaying) {
    startSong(requested);
    return;
  }

  // If currently playing the same song: stop it
  if (currentSong == requested) {
    stopSong(currentSong);
    return;
  }

  // Otherwise: switch from current to requested
  switchSong(currentSong, requested);
}

// Poll buttons frequently so stop/switch works during playback delays
static void pollButtonsDuringPlayback() {
  if (pressedEdge(BTN1_PIN, stable1, raw1, lastChange1)) handleSongButton(SONG_1);
  if (pressedEdge(BTN2_PIN, stable2, raw2, lastChange2)) handleSongButton(SONG_2);
  if (pressedEdge(BTN3_PIN, stable3, raw3, lastChange3)) handleSongButton(SONG_3);
}

// Delay that remains responsive to buttons and OLED
static void responsiveDelay(uint16_t ms) {
  uint32_t start = millis();
  while (!stopRequested && (millis() - start) < ms) {
    pollButtonsDuringPlayback();
    oledTick();
    delay(1);
  }
}

// ---------------------- Music playback ----------------------

static void playSongBlocking(
  const uint16_t *freqArr,
  const uint16_t *durArr,
  const uint16_t *gateArr,
  uint16_t nEvents
) {
  for (uint16_t i = 0; i < nEvents; i++) {
    if (stopRequested) break;

    uint16_t freq = pgm_read_word(&freqArr[i]);
    uint16_t dur  = pgm_read_word(&durArr[i]);
    uint16_t gate = pgm_read_word(&gateArr[i]);

    dur  = scaleMs(dur);
    gate = scaleMs(gate);
    if (gate > dur) gate = dur;

    if (freq == 0) {
      noTone(BUZZ_PIN);
      if (dur) responsiveDelay(dur);
      continue;
    }

    if (gate > 0) {
      tone(BUZZ_PIN, freq);
      responsiveDelay(gate);
    }

    noTone(BUZZ_PIN);
    uint16_t offMs = dur - gate;
    if (offMs > 0) responsiveDelay(offMs);

    if (EXTRA_GAP_MS && !stopRequested) responsiveDelay(EXTRA_GAP_MS);
  }

  noTone(BUZZ_PIN);
}

// ---------------------- Setup / Loop ----------------------

void setup() {
  pinMode(BUZZ_PIN, OUTPUT);
  noTone(BUZZ_PIN);

  pinMode(BTN1_PIN, INPUT_PULLUP);
  pinMode(BTN2_PIN, INPUT_PULLUP);
  pinMode(BTN3_PIN, INPUT_PULLUP);

  Wire.begin();
  if (!display.begin(SSD1306_SWITCHCAPVCC, OLED_ADDR)) {
    while (true) {}
  }

  display.clearDisplay();
  display.display();

  lastSwapMs = millis();
  currentImage = 0;
  drawBitmapByIndex(currentImage);
}

void loop() {
  // Always keep OLED swapping (or showing message)
  oledTick();

  // If idle: wait for a press
  if (!isPlaying) {
    if (pressedEdge(BTN1_PIN, stable1, raw1, lastChange1)) handleSongButton(SONG_1);
    if (pressedEdge(BTN2_PIN, stable2, raw2, lastChange2)) handleSongButton(SONG_2);
    if (pressedEdge(BTN3_PIN, stable3, raw3, lastChange3)) handleSongButton(SONG_3);
    return;
  }

  // If playing: run the current song (it can be stopped/switched mid-way)
  switch (currentSong) {
    case SONG_1:
      playSongBlocking(SONG1_FREQ_HZ, SONG1_DUR_MS, SONG1_GATE_MS, N_EVENTS_SONG1);
      break;
    case SONG_2:
      playSongBlocking(SONG2_FREQ_HZ, SONG2_DUR_MS, SONG2_GATE_MS, N_EVENTS_SONG2);
      break;
    case SONG_3:
      playSongBlocking(SONG3_FREQ_HZ, SONG3_DUR_MS, SONG3_GATE_MS, N_EVENTS_SONG3);
      break;
    default:
      break;
  }

  // Song ended naturally or we got a stop request.
  // Clear stop request so next behavior is clean.
  stopRequested = false;

  // If a switch was requested during playback, start the next song immediately.
  if (switchPending && nextSong != SONG_NONE) {
    SongId toStart = nextSong;
    switchPending = false;
    nextSong = SONG_NONE;

    // Start without waiting for another button press
    currentSong = toStart;
    isPlaying = true;
    // OLED message for switch was already shown in handleSongButton()
    return;
  }

  // Otherwise, we are done playing.
  isPlaying = false;
  currentSong = SONG_NONE;
}
